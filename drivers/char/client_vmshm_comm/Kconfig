## drivers/char/client_vmshm_comm/Kconfig
```kconfig
# SPDX-License-Identifier: GPL-2.0

config CLIENT_VMSHM_COMM
	bool "client_comm_vmshm communication device"
	depends on ARM64 && REALM_XSHM
	default n
	help
	  Client side of the RMM-authorized Realm shared queue transport.
	  Pool binding creates the platform device with authenticated channel
	  identity. Notifications require RMM IRQ subscription and ACK_ARM.
	  Host-provided DT windows, memfd and MMIO doorbells are unsupported.


config CLIENT_VMSHM_COMM_HELLO_SELFTEST
	bool "Send client_comm_vmshm hello-world self-test request"
	depends on CLIENT_VMSHM_COMM
	default n
	help
	  Send a "hello_world" request to the proxy side after the client comm
	  driver attaches to the shared transport, then wait for the proxy ACK.

	  Enable only for bring-up/debugging, together with
	  PROXY_VMSHM_COMM_HELLO_SELFTEST in the proxy VM kernel.

config CLIENT_VMSHM_COMM_PERF_SELFTEST
	bool "Run client_comm_vmshm no-op RPC performance self-test"
	depends on CLIENT_VMSHM_COMM
	default n
	help
	  Run a boot-time benchmark that sends no-op RPCs through the vmshm
	  comm path, prints RTT and burst-throughput statistics, and reports
	  IRQ-handler to worker-start latency observed by both guests.

	  Enable only for bring-up/performance debugging, together with
	  PROXY_VMSHM_COMM_PERF_SELFTEST in the proxy VM kernel.
```

## drivers/char/client_vmshm_manager/Kconfig
```kconfig
# SPDX-License-Identifier: GPL-2.0

config CLIENT_VMSHM_MANAGER
	bool "client vmshm manager shared memory character device"
	depends on ARM64 && REALM_XSHM
	depends on CLIENT_VMSHM_COMM
	default n
	help
	  Client object view for RMM-authorized Realm pools.
	  Pool bind/unbind controls backing lifetime; no Host DT window or
	  raw shared-window character device is registered.
```

## drivers/char/proxy_vmshm_comm/Kconfig
```kconfig
# SPDX-License-Identifier: GPL-2.0

config PROXY_VMSHM_COMM
	bool "proxy_comm_vmshm communication device"
	depends on ARM64 && REALM_XSHM
	default n
	help
	  Proxy side of the RMM-authorized Realm shared queue transport.
	  Pool binding creates the platform device with authenticated channel
	  identity. Notifications require RMM IRQ subscription and ACK_ARM.
	  Host-provided DT windows, memfd and MMIO doorbells are unsupported.


config PROXY_VMSHM_COMM_HELLO_SELFTEST
	bool "Register proxy_comm_vmshm hello-world self-test handler"
	depends on PROXY_VMSHM_COMM
	default n
	help
	  Register a small in-kernel handler that waits for the client side to
	  send the string "hello_world" over the vmshm control channel, then
	  prints the received string to the kernel log and replies with an ACK.

	  Enable only for bring-up/debugging.

config PROXY_VMSHM_COMM_PERF_SELFTEST
	bool "Register proxy_comm_vmshm no-op performance self-test handlers"
	depends on PROXY_VMSHM_COMM
	default n
	help
	  Register no-op echo and performance-report handlers used by the
	  client_comm_vmshm boot-time performance self-test.

	  Enable only for bring-up/performance debugging.
```

## drivers/char/proxy_vmshm_manager/Kconfig
```kconfig
# SPDX-License-Identifier: GPL-2.0

config PROXY_VMSHM_MANAGER
	bool "proxy vmshm manager shared memory character device"
	depends on ARM64 && REALM_XSHM
	default n
	help
	  Proxy object allocator for RMM-authorized Realm pools.
	  Pool bind/unbind controls backing lifetime; no Host DT window or
	  raw shared-window character device is registered.


config PROXY_VMSHM_MANAGER_SELFTEST
	bool "Check Realm pool permissions and exact object extents"
	depends on PROXY_VMSHM_MANAGER
	default n
	help
	  Run per-domain permission and exact page-extent allocation checks
	  when an RMM-authorized pool is bound.
```
